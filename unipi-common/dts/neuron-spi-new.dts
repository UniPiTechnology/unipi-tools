/dts-v1/;

/ {
	compatible = "brcm,bcm2835\0brcm,bcm2836\0brcm,bcm2708\0brcm,bcm2709";

	fragment@0 {
		target = < 0xdeadbeef >;

		__overlay__ {
			#address-cells = < 0x01 >;
			#size-cells = < 0x00 >;
			status = "okay";
			pinctrl-0 = < 0xdeadbeef 0xdeadbeef >;
			cs-gpios = < 0xdeadbeef 0x08 0x01 0xdeadbeef 0x07 0x01 0xdeadbeef 0x18 0x01 0xdeadbeef 0x19 0x01 >;
			linux,phandle = < 0x04 >;
			phandle = < 0x04 >;

			neuronspi@0 {
				compatible = "unipi,neuron";
				reg = < 0x01 >;
				#address-cells = < 0x01 >;
				#size-cells = < 0x00 >;
				spi-max-frequency = < 0xb71b00 >;
				pinctrl-0 = < 0x01 >;
				pinctrl-names = "default";
				interrupt-parent = < 0xdeadbeef >;
				interrupts = < 0x1b 0x01 >;
				status = "okay";
				neuron-board-index = < 0x00 >;
				neuron-probe-always-succeeds = < 0x00 >;
				linux,phandle = < 0x05 >;
				phandle = < 0x05 >;
			};

			neuronspi@1 {
				compatible = "unipi,neuron";
				reg = < 0x02 >;
				#address-cells = < 0x01 >;
				#size-cells = < 0x00 >;
				spi-max-frequency = < 0x124f80 >;
				pinctrl-0 = < 0x02 >;
				pinctrl-names = "default";
				interrupt-parent = < 0xdeadbeef >;
				interrupts = < 0x17 0x01 >;
				status = "okay";
				neuron-board-index = < 0x01 >;
				neuron-probe-always-succeeds = < 0x00 >;
				linux,phandle = < 0x06 >;
				phandle = < 0x06 >;
			};

			neuronspi@2 {
				compatible = "unipi,neuron";
				reg = < 0x03 >;
				#address-cells = < 0x01 >;
				#size-cells = < 0x00 >;
				spi-max-frequency = < 0x124f80 >;
				pinctrl-names = "default";
				pinctrl-0 = < 0x03 >;
				interrupt-parent = < 0xdeadbeef >;
				interrupts = < 0x16 0x01 >;
				status = "okay";
				neuron-board-index = < 0x02 >;
				neuron-probe-always-succeeds = < 0x00 >;
				linux,phandle = < 0x07 >;
				phandle = < 0x07 >;
			};
		};
	};

	fragment@1 {
		target = < 0xdeadbeef >;

		__overlay__ {
			status = "okay";
		};
	};

	fragment@2 {
		target = < 0xdeadbeef >;

		__overlay__ {
			status = "disabled";
		};
	};

	fragment@3 {
		target = < 0xdeadbeef >;

		__overlay__ {

			spi0_cs_pins {
				brcm,pins = < 0x08 0x07 0x18 0x19 >;
				brcm,function = < 0x01 >;
				brcm,pull = < 0x00 >;
			};

			neuron_0_irq_pin {
				brcm,pins = < 0x1b >;
				brcm,function = < 0x00 >;
				brcm,pull = < 0x01 >;
				linux,phandle = < 0x01 >;
				phandle = < 0x01 >;
			};

			neuron_1_irq_pin {
				brcm,pins = < 0x17 >;
				brcm,function = < 0x00 >;
				brcm,pull = < 0x01 >;
				linux,phandle = < 0x02 >;
				phandle = < 0x02 >;
			};

			neuron_2_irq_pin {
				brcm,pins = < 0x16 >;
				brcm,function = < 0x00 >;
				brcm,pull = < 0x01 >;
				linux,phandle = < 0x03 >;
				phandle = < 0x03 >;
			};
		};
	};

	__overrides__ {
		cs0_pin = [ 00 00 00 04 63 73 2d 67 70 69 6f 73 3a 34 00 de ad be ef 62 72 63 6d 2c 70 69 6e 73 3a 30 00 ];
		cs1_pin = < 0x04 0x63732d67 0x70696f73 0x3a313600 0xdeadbeef 0x6272636d 0x2c70696e 0x733a3400 >;
		cs2_pin = [ 00 00 00 04 63 73 2d 67 70 69 6f 73 3a 34 30 00 de ad be ef 62 72 63 6d 2c 70 69 6e 73 3a 31 32 00 ];
		cs3_pin = < 0x04 0x63732d67 0x70696f73 0x3a323800 0xdeadbeef 0x6272636d 0x2c70696e 0x733a3800 >;
		neuron_irq_0 = [ 00 00 00 05 69 6e 74 65 72 72 75 70 74 73 3a 30 00 00 00 00 01 62 72 63 6d 2c 70 69 6e 73 3a 30 00 ];
		neuron_irq_1 = [ 00 00 00 06 69 6e 74 65 72 72 75 70 74 73 3a 30 00 00 00 00 02 62 72 63 6d 2c 70 69 6e 73 3a 30 00 ];
		neuron_irq_2 = [ 00 00 00 07 69 6e 74 65 72 72 75 70 74 73 3a 30 00 00 00 00 03 62 72 63 6d 2c 70 69 6e 73 3a 30 00 ];
	};

	__symbols__ {
		frag0 = "/fragment@0/__overlay__";
		neuronspi0 = "/fragment@0/__overlay__/neuronspi@0";
		neuronspi1 = "/fragment@0/__overlay__/neuronspi@1";
		neuronspi2 = "/fragment@0/__overlay__/neuronspi@2";
		neuron_0_irq_pin = "/fragment@3/__overlay__/neuron_0_irq_pin";
		neuron_1_irq_pin = "/fragment@3/__overlay__/neuron_1_irq_pin";
		neuron_2_irq_pin = "/fragment@3/__overlay__/neuron_2_irq_pin";
	};

	__local_fixups__ {

		fragment@0 {

			__overlay__ {

				neuronspi@0 {
					pinctrl-0 = < 0x00 >;
				};

				neuronspi@1 {
					pinctrl-0 = < 0x00 >;
				};

				neuronspi@2 {
					pinctrl-0 = < 0x00 >;
				};
			};
		};

		__overrides__ {
			cs0_pin = < 0x00 >;
			cs1_pin = < 0x00 >;
			cs2_pin = < 0x00 >;
			cs3_pin = < 0x00 >;
			neuron_irq_0 = < 0x00 0x11 >;
			neuron_irq_1 = < 0x00 0x11 >;
			neuron_irq_2 = < 0x00 0x11 >;
		};
	};

	__fixups__ {
		spi0 = "/fragment@0:target:0";
		spi0_pins = "/fragment@0/__overlay__:pinctrl-0:0";
		spi0_cs_pins = "/fragment@0/__overlay__:pinctrl-0:4\0/__overrides__:cs0_pin:15\0/__overrides__:cs1_pin:16\0/__overrides__:cs2_pin:16\0/__overrides__:cs3_pin:16";
		gpio = "/fragment@0/__overlay__:cs-gpios:0\0/fragment@0/__overlay__:cs-gpios:12\0/fragment@0/__overlay__:cs-gpios:24\0/fragment@0/__overlay__:cs-gpios:36\0/fragment@0/__overlay__/neuronspi@0:interrupt-parent:0\0/fragment@0/__overlay__/neuronspi@1:interrupt-parent:0\0/fragment@0/__overlay__/neuronspi@2:interrupt-parent:0\0/fragment@3:target:0";
		spidev0 = "/fragment@1:target:0";
		spidev1 = "/fragment@2:target:0";
	};
};
