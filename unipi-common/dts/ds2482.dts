/dts-v1/;

/ {
	compatible = "brcm,bcm2708";

	fragment@0 {
		target = < 0xdeadbeef >;

		__overlay__ {
			#address-cells = < 0x01 >;
			#size-cells = < 0x00 >;
			status = "okay";

			ds2482@18 {
				compatible = "ds2482";
				#pwm-cells = < 0x02 >;
				reg = < 0x18 >;
				status = "okay";
				linux,phandle = < 0x01 >;
				phandle = < 0x01 >;
			};
		};
	};

	__overrides__ {
		addr = [ 00 00 00 01 72 65 67 3a 30 00 ];
	};

	__symbols__ {
		ds2482 = "/fragment@0/__overlay__/ds2482@18";
	};

	__local_fixups__ {

		__overrides__ {
			addr = < 0x00 >;
		};
	};

	__fixups__ {
		i2c_arm = "/fragment@0:target:0";
	};
};
