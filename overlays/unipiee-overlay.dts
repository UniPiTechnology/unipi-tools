/dts-v1/;
/plugin/;

/ {
	compatible = "brcm,bcm2835";

	fragment@0 {
		target = <&i2c1>;

		__overlay__ {
			#address-cells = < 0x01 >;
			#size-cells = < 0x00 >;
			status = "okay";

			unipiee: 24c02@50 {
				compatible = "atmel,24c02";
				reg = <0x50>;
				status = "okay";
			};
		};
	};
};
