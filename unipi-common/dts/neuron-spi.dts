/dts-v1/;

/ {
	compatible = "brcm,bcm2835\0brcm,bcm2836\0brcm,bcm2708\0brcm,bcm2709";

	fragment@0 {
		target = < 0xffffffff >;

		__overlay__ {
			#address-cells = < 0x01 >;
			#size-cells = < 0x00 >;
			pinctrl-0 = < 0xffffffff 0x01 >;
			status = "okay";
			cs-gpios = < 0xffffffff 0x08 0x01 0xffffffff 0x07 0x01 0xffffffff 0x19 0x01 0xffffffff 0x18 0x01 >;
			linux,phandle = < 0x02 >;
			phandle = < 0x02 >;

			spidev@2 {
				compatible = "spidev";
				reg = < 0x02 >;
				#address-cells = < 0x01 >;
				#size-cells = < 0x00 >;
				spi-max-frequency = < 0x7a120 >;
			};

			spidev@3 {
				compatible = "spidev";
				reg = < 0x03 >;
				#address-cells = < 0x01 >;
				#size-cells = < 0x00 >;
				spi-max-frequency = < 0x7a120 >;
			};
		};
	};

	fragment@1 {
		target = < 0xffffffff >;

		__overlay__ {

			spi0_cs_pins {
				brcm,pins = < 0x08 0x07 0x19 0x18 >;
				brcm,function = < 0x01 >;
				linux,phandle = < 0x01 >;
				phandle = < 0x01 >;
			};
		};
	};

	__overrides__ {
		cs0_pin = [ 00 00 00 02 63 73 2d 67 70 69 6f 73 3a 34 00 00 00 00 01 62 72 63 6d 2c 70 69 6e 73 3a 30 00 ];
		cs1_pin = < 0x02 0x63732d67 0x70696f73 0x3a313600 0x01 0x6272636d 0x2c70696e 0x733a3400 >;
		cs2_pin = < 0x02 0x63732d67 0x70696f73 0x3a323800 0x01 0x6272636d 0x2c70696e 0x733a3800 >;
		cs3_pin = [ 00 00 00 02 63 73 2d 67 70 69 6f 73 3a 34 30 00 00 00 00 01 62 72 63 6d 2c 70 69 6e 73 3a 31 32 00 ];
	};

	__symbols__ {
		frag0 = "/fragment@0/__overlay__";
		spi0_cs_pins = "/fragment@1/__overlay__/spi0_cs_pins";
	};

	__fixups__ {
		spi0 = "/fragment@0:target:0";
		spi0_pins = "/fragment@0/__overlay__:pinctrl-0:0";
		gpio = "/fragment@0/__overlay__:cs-gpios:0\0/fragment@0/__overlay__:cs-gpios:12\0/fragment@0/__overlay__:cs-gpios:24\0/fragment@0/__overlay__:cs-gpios:36\0/fragment@1:target:0";
	};

	__local_fixups__ {

		fragment@0 {

			__overlay__ {
				pinctrl-0 = < 0x04 >;
			};
		};

		__overrides__ {
			cs0_pin = < 0x00 0x0f >;
			cs1_pin = < 0x00 0x10 >;
			cs2_pin = < 0x00 0x10 >;
			cs3_pin = < 0x00 0x10 >;
		};
	};
};
