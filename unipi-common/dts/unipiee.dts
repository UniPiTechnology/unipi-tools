/dts-v1/;

/ {
	compatible = "brcm,bcm2708";

	fragment@0 {
		target = < 0xdeadbeef >;

		__overlay__ {
			#address-cells = < 0x01 >;
			#size-cells = < 0x00 >;
			status = "okay";

			24c02@50 {
				compatible = "24c02";
				#pwm-cells = < 0x02 >;
				reg = < 0x50 >;
				status = "okay";
			};
		};
	};

	__symbols__ {
		unipiee = "/fragment@0/__overlay__/24c02@50";
	};

	__fixups__ {
		i2c_arm = "/fragment@0:target:0";
	};
};
